## tests/bluetooth/controller/ctrl_frame_space_update/testcase.yaml
```yaml
common:
  tags:
    - bluetooth
    - bt_frame_space_update
    - bt_ull_llcp
tests:
  bluetooth.controller.ctrl_frame_space_update.test:
    type: unit
```
