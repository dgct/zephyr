## tests/bluetooth/controller/ctrl_conn_rate/testcase.yaml
```yaml
common:
  tags:
    - bluetooth
    - bt_conn_rate
    - bt_ull_llcp
tests:
  bluetooth.controller.ctrl_conn_rate.test:
    type: unit
```

## tests/bluetooth/controller/ctrl_feature_exchange_ext/testcase.yaml
```yaml
common:
  tags:
    - bluetooth
    - bt_feature_exchange_ext
    - bt_ull_llcp
tests:
  bluetooth.controller.ctrl_feature_exchange_ext.test:
    type: unit
```
